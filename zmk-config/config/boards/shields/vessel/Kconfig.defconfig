## zmk-config/config/west.yml
```yaml
manifest:
  remotes:
    - name: zmkfirmware
      url-base: https://github.com/zmkfirmware
    - name: badjeff
      url-base: https://github.com/badjeff
  projects:
    - name: zmk
      remote: zmkfirmware
      # Pinned to a modern main SHA (Hardware Model v2, board `xiao_ble`,
      # Zephyr 4.1). Chosen so the CAP1188 can use Zephyr's stock
      # `microchip,cap12xx` input driver (absent from the older v0.3.0 /
      # Zephyr 3.5 line). Transitively pins Zephyr via app/west.yml.
      revision: 83bc82dbfdcda4ef392461202534a7cc337ca055
      import: app/west.yml
    # PMW3610 trackball driver (community). Pinned to a specific commit so a
    # green build stays reproducible instead of floating on the fork's main.
    - name: zmk-pmw3610-driver
      remote: badjeff
      revision: 44b4a76b74d293a93cec4ccb7e04cb8d29c10f93
  self:
    path: config
```

## zmk-config/modules/orbit/Kconfig
```kconfig
# ORBit repo-local Zephyr module. Home for the small pieces of custom firmware
# the spec's work package needs and ZMK doesn't ship: the slider chord input
# processor (item 4) and, later, the DRV2605L haptics driver (item 5).

config ORBIT_INPUT_PROCESSOR_CHORD
	bool "ORBit two-pad chord input processor"
	default y
	depends on DT_HAS_ORBIT_INPUT_PROCESSOR_CHORD_ENABLED
	depends on INPUT
	help
	  Input processor that turns a near-simultaneous touch of two EV_KEY
	  codes into a single third code (spec: CS7+CS8 slider chord = mute),
	  while single touches pass through with a short detection delay.

config ORBIT_HAPTIC_FEEDBACK
	bool "ORBit touch-zone haptic feedback (DRV2605L)"
	default y
	depends on DT_HAS_ORBIT_HAPTIC_FEEDBACK_ENABLED
	depends on HAPTICS_DRV2605
	depends on SETTINGS
	depends on INPUT
	help
	  Plays a DRV2605 ROM library effect per touch-zone press, and runs the
	  LRA auto-calibration once at boot, persisting the result via settings
	  (spec item 5: init + auto-cal at boot with persist, per-zone effect,
	  touch-to-haptic < 10 ms).

config ORBIT_GLOW
	bool "ORBit SK6812 glow engine"
	default y
	depends on DT_HAS_ORBIT_GLOW_ENABLED
	depends on LED_STRIP
	depends on INPUT
	help
	  Amber glow scenes on the SK6812 chain (spec item 6): low-duty idle,
	  zone flash on touch, breathe hook for item 7's wake mask, all-off on
	  ZMK idle/sleep. Subscribes to ZMK activity events.

config ORBIT_WAKE
	bool "ORBit sleep wake sources (IMU motion + touch proximity)"
	default y
	depends on DT_HAS_ORBIT_WAKE_ENABLED
	depends on I2C
	depends on GPIO
	help
	  Arms LSM6DS3TR-C wake-on-motion and CAP1188 standby proximity as
	  System OFF wake pins on the ZMK sleep transition, and triggers the
	  boot glow breathe that masks BLE reconnect (spec item 7).

config ORBIT_PROFILE_INDICATOR
	bool "ORBit BLE profile step feedback"
	default y
	depends on ZMK_BLE
	depends on ORBIT_GLOW || ORBIT_HAPTIC_FEEDBACK
	help
	  Haptic tick and LED index blink on every active-profile change
	  (spec item 8: "haptic tick per step, LED0-4 blink index").
```

## zmk-config/modules/orbit/dts/bindings/haptics/orbit,haptic-feedback.yaml
```yaml
# Copyright (c) 2026 ORBit
# SPDX-License-Identifier: MIT

description: |
  Glue between an input device's EV_KEY events and a DRV2605 haptic driver
  (spec §4 item 5): fires one ROM-library effect per zone press, and owns the
  LRA auto-calibration lifecycle (run once at boot, persist via settings,
  restore on later boots, switch the chip to closed-loop on success).

compatible: "orbit,haptic-feedback"

properties:
  haptics:
    type: phandle
    required: true
    description: The ti,drv2605 device to play effects on.
  input-dev:
    type: phandle
    required: true
    description: Input device whose EV_KEY presses trigger effects.
  codes:
    type: array
    required: true
    description: EV_KEY codes to react to.
  effects:
    type: array
    required: true
    description: |
      DRV2605 ROM library effect ID per code (same order/length as codes).
      TI DRV2605L datasheet table 11.2 lists all 123; useful ones: 1 strong
      click 100%, 4 sharp click 100%, 5 sharp click 60%, 7 soft bump 100%,
      10 double click 100%, 24 sharp tick 1 100%, 26 sharp tick 3 60%.
  dedup-ms:
    type: int
    default: 90
    description: |
      Minimum ms between effects for the SAME code. Must stay just above the
      slider chord window (slider_chord timeout-ms): the chord processor
      re-injects held-back CS7/CS8 presses, and without this window every
      slider tap would buzz twice (raw press + injected replay).
  boot-cal-delay-ms:
    type: int
    default: 800
    description: |
      Delay after boot before restoring/running LRA auto-calibration, giving
      the settings backend and I2C bus time to come up. Auto-cal buzzes the
      motor for up to ~1 s on the very first boot only.
  lra-drive-time:
    type: int
    default: 255
    description: |
      Optional DRV2605 CONTROL1.DRIVE_TIME (0-31) written before auto-cal.
      Should be the LRA half-period: DRIVE_TIME = ((1000/f_hz)/2 - 0.5)/0.1,
      e.g. 24 for a 170 Hz LRA, 19 (chip default) fits ~205 Hz. Values > 31
      (the 255 default) leave the chip default untouched. Set this once the
      LRA's datasheet frequency is known.
```

## zmk-config/modules/orbit/dts/bindings/input_processor/orbit,input-processor-chord.yaml
```yaml
# Copyright (c) 2026 ORBit
# SPDX-License-Identifier: MIT

description: |
  Input processor that chords two EV_KEY codes into a third.

  A press of either code is held back for timeout-ms. If the other code is
  pressed inside that window, the pair is delivered as a single press of
  chord-code (released when the first of the two fingers lifts). Otherwise
  the original press is delivered, delayed by at most timeout-ms.

  Must be placed BEFORE the zmk,input-processor-behaviors entry in the
  listener's input-processors list, so the behaviors map sees the rewritten
  codes.

compatible: "orbit,input-processor-chord"

properties:
  "#input-processor-cells":
    type: int
    required: true
    const: 0
  # Read by ZMK's input-listener entry macro on every processor node.
  track-remainders:
    type: boolean
  codes:
    type: array
    required: true
    description: Exactly two EV_KEY codes that form the chord.
  chord-code:
    type: int
    required: true
    description: EV_KEY code delivered when both codes are pressed together.
  timeout-ms:
    type: int
    default: 75
    description: |
      Chord detection window in ms. Also the worst-case added latency on a
      single (non-chord) tap of either code.
```

## zmk-config/modules/orbit/dts/bindings/led/orbit,glow.yaml
```yaml
# Copyright (c) 2026 ORBit
# SPDX-License-Identifier: MIT

description: |
  ORBit glow scene engine (spec §4 item 6): drives the SK6812 chain through
  the Zephyr led_strip API. Amber-family only, per the identity guardrails
  (spec §7). Scenes: low-duty idle glow while active, per-zone flash on
  touch, breathe (used by item 7 to mask BLE reconnect on proximity wake),
  all-off on ZMK idle and sleep. No other animations.

compatible: "orbit,glow"

properties:
  led-strip:
    type: phandle
    required: true
    description: The led_strip device (worldsemi,ws2812-spi node).
  input-dev:
    type: phandle
    required: true
    description: Input device whose EV_KEY presses flash zone LEDs.
  codes:
    type: array
    required: true
    description: EV_KEY codes that flash a zone LED.
  zone-leds:
    type: array
    required: true
    description: LED chain index per code (same order/length as codes).
  color-hex:
    type: int
    default: 0xFFB457
    description: |
      Base glow color as 0xRRGGBB. IDENTITY GUARDRAIL (spec §7): must stay
      in the amber #FFB457 family — no RGB theatrics.
  idle-brightness:
    type: int
    default: 8
    description: Idle scene duty, percent of color-hex (the spec's "idle low duty").
  flash-brightness:
    type: int
    default: 30
    description: |
      Zone-flash duty, percent. Also the effective global cap: spec limits
      glow to <= 30% on battery.
  flash-ms:
    type: int
    default: 180
    description: Zone flash duration on touch.
  breathe-period-ms:
    type: int
    default: 1600
    description: One inhale+exhale of the breathe scene (item 7 wake mask).
```

## zmk-config/modules/orbit/dts/bindings/misc/orbit,wake.yaml
```yaml
# Copyright (c) 2026 ORBit
# SPDX-License-Identifier: MIT

description: |
  ORBit sleep/wake sources (spec §4 item 7). On the ZMK SLEEP transition,
  arms two System-OFF wake paths, then lets ZMK power the SoC off:

    - LSM6DS3TR-C wake-on-motion, programmed via raw I2C (this node sits at
      the IMU's bus address; no sensor driver is used or needed) with the
      interrupt routed to INT1 and the pin armed as a level wake (nRF SENSE).
    - CAP1188 standby proximity: CS7+CS8 ganged as a proximity antenna in
      the chip's low-power cycled standby mode; ALERT armed as the second
      wake pin.

  Waking from System OFF is a reset, so "wake" is a fresh boot; at boot this
  module triggers the glow breathe scene to mask the 1-2 s BLE reconnect.

compatible: "orbit,wake"

on-bus: i2c

properties:
  reg:
    type: array
    required: true
  imu-int-gpios:
    type: phandle-array
    required: true
    description: LSM6DS3TR-C INT1 (P0.11 on the XIAO internal wiring).
  touch:
    type: phandle
    required: true
    description: |
      The CAP1188 node (microchip,cap12xx). Provides the bus address for the
      standby-proximity register writes and the ALERT pin (its int-gpios).
  wake-threshold:
    type: int
    default: 2
    description: |
      IMU WAKE_UP_THS in FS/64 steps at 2 g full scale (2 = 62.5 mg).
      Raise if the device wakes from desk bumps; lower if a deliberate
      touch doesn't wake it.
  proximity-sensitivity:
    type: int
    default: 6
    description: |
      CAP1188 STANDBY_SENSITIVITY (0-7, higher = more sensitive). Tune with
      the sleeve fitted; too high self-triggers on drift.
  proximity-threshold:
    type: int
    default: 4
    description: CAP1188 STANDBY_THRESHOLD delta counts for proximity.
  breathe-ms:
    type: int
    default: 2000
    description: Boot breathe duration (the BLE reconnect mask).
```
